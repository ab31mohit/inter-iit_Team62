## px4_modules/fail_motor/Kconfig
```kconfig
menuconfig EXAMPLES_FAIL_MOTOR
	bool "fail_motor"
	default n
	---help---
		Enable support for fail_motor
```

## px4_modules/gazebo_classic_fault_tolerant_control/Kconfig
```kconfig
menuconfig EXAMPLES_GAZEBO_CLASSIC_FAULT_TOLERANT_CONTROL
	bool "gazebo_classic_fault_tolerant_control"
	default n
	---help---
		Enable support for hover
```

## px4_modules/motor_failure/Kconfig
```kconfig
menuconfig EXAMPLES_MOTOR_FAILURE
	bool "motor_failure"
	default n
	---help---
		Enable support for motor_failure
```

## px4_modules/single_motor_failure/Kconfig
```kconfig
menuconfig EXAMPLES_SINGLE_MOTOR_FAILUREE
	bool "single_motor_failuree"
	default n
	---help---
		Enable support for single_motor_failure
```
